## meta-mylayer/conf/distro/bingo.conf
```bitbake
DISTRO_NAME = "Bingo Linux"
DISTRO_VERSION = "0.1"

# add non-root user
INHERIT += "extrausers"
EXTRA_USERS_PARAMS = "useradd -P cc -m cc;"

# set root password
EXTRA_USERS_PARAMS += "usermod -P root root;"

# default to read-only-rootfs
# IMAGE_FEATURES = "read-only-rootfs"
```

## meta-mylayer/conf/machine/raspberrypi3-64-extra.conf
```bitbake
# Add support for CAN + GPS
RPI_KERNEL_DEVICETREE_OVERLAYS_append = " overlays/mcp2515-can0.dtbo"
# Fix for CAN
SERIAL_CONSOLES = ""
```
